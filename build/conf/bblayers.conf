## build/conf/bblayers.conf
```bitbake
# POKY_BBLAYERS_CONF_VERSION is increased each time build/conf/bblayers.conf
# changes incompatibly
POKY_BBLAYERS_CONF_VERSION = "2"

BBPATH = "${TOPDIR}"
BBFILES ?= ""

BBLAYERS ?= " \
  ${BBPATH}/../poky/meta \
  ${BBPATH}/../meta-openembedded/meta-oe \
  ${BBPATH}/../meta-openembedded/meta-networking \
  ${BBPATH}/../meta-openembedded/meta-python \
  ${BBPATH}/../meta-openembedded/meta-webserver \
  ${BBPATH}/../poky/meta-poky \
  ${BBPATH}/../poky/meta-yocto-bsp \
  ${BBPATH}/../meta-raspberrypi \
  ${BBPATH}/../meta-qt5 \
  ${BBPATH}/../meta-photobooth \
  "
```

## meta-photobooth/conf/layer.conf
```bitbake
# We have a conf and classes directory, append to BBPATH
BBPATH =. "${LAYERDIR}:"

# We have a recipes directory, add to BBFILES
BBFILES += "${LAYERDIR}/recipes*/*/*.bbappend ${LAYERDIR}/recipes*/*/*.bb ${LAYERDIR}/images/*.bb"

BBFILE_COLLECTIONS += "photobooth"
BBFILE_PATTERN_photobooth = "^${LAYERDIR}/"
BBFILE_PRIORITY_photobooth = "11"

LAYERDEPENDS_photobooth = "core"

LAYERSERIES_COMPAT_raspberrypi = "sumo thud warrior zeus"

LICENSE_PATH += "${LAYERDIR}/licenses"

# The dynamic-layers directory hosts the extensions and layer specific
# modifications.
#
# The .bbappend and .bb files are included if the respective layer
# collection is available.
BBFILES += "${@' '.join('${LAYERDIR}/dynamic-layers/%s/recipes*/*/*.bbappend' % layer \
               for layer in BBFILE_COLLECTIONS.split())}"
BBFILES += "${@' '.join('${LAYERDIR}/dynamic-layers/%s/recipes*/*/*.bb' % layer \
               for layer in BBFILE_COLLECTIONS.split())}"
```
